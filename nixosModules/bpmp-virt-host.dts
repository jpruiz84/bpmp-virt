/dts-v1/;
/plugin/;
/ {
bpmp_host_proxy: bpmp_host_proxy {
     compatible = "nvidia,bpmp-host-proxy";
     allowed-clocks = <TEGRA234_CLK_UARTA 
                     TEGRA234_CLK_PLLP_OUT0>;
     allowed-resets = <TEGRA234_RESET_UARTA>;				  
     status = "okay";
 };
};
