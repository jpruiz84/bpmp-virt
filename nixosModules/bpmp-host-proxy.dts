/dts-v1/;

/ {
compatible="nvidia,tegra186";
bpmp_host_proxy: bpmp_host_proxy {
				compatible = "nvidia,bpmp_host_proxy";
				allowed-clocks = <155
                     102>;
				allowed-reset = <100>;
        status = "okay";
    };
};
